## boards/emma_louise/board.yml
```yaml
board:
  name: emma_louise
  vendor: forgetfulpigeonkeyboards
  socs:
  - name: nrf52840
```

## config/west.yml
```yaml
manifest:
  defaults:
    revision: v0.3
  remotes:
    - name: zmkfirmware
      url-base: https://github.com/zmkfirmware
    - name: zmk-keyboard-emma_louise
      url-base: https://github.com/Max585t/zmk-keyboard-emma-louise
    # Additional modules containing boards/shields/custom code can be listed here as well
    # See https://docs.zephyrproject.org/3.2.0/develop/west/manifest.html#projects
  projects:
    - name: zmk
      remote: zmkfirmware
      import: app/west.yml
  self:
    path: config
```
